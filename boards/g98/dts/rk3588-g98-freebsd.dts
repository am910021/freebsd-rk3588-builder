/*-
 * SPDX-License-Identifier: BSD-2-Clause
 *
 * Copyright (c) 2026 Fang, Wei-Xiang (Yuri) <am910021@gmail.com>
 */

/dts-v1/;

#include "rk3588.dtsi"
#include "rk3588-g98-base.dtsi"
#include "rk3588-g98.dtsi"

/ {
	model = "G98 RK3588";
	compatible = "g98,rk3588", "rockchip,rk3588";

	crypto@fe370000 {
		compatible = "rockchip,rk3588-crypto";
		reg = <0x0 0xfe370000 0x0 0x2000>;
		interrupts = <GIC_SPI 209 IRQ_TYPE_LEVEL_HIGH 0>;
		clocks = <&scmi_clk SCMI_CRYPTO_CORE>,
			 <&scmi_clk SCMI_ACLK_SECURE_NS>,
			 <&scmi_clk SCMI_HCLK_SECURE_NS>;
		clock-names = "core", "aclk", "hclk";
		resets = <&scmi_reset SCMI_SRST_CRYPTO_CORE>;
		reset-names = "core";
		status = "okay";
	};
};

&gmac0 {
	max-frame-size = <9000>;
};

&gmac1 {
	max-frame-size = <9000>;
};
